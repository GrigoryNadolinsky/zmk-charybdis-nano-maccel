## config/west.yml
```yaml
manifest:
  remotes:
    - name: zmkfirmware
      url-base: https://github.com/petejohanson
    - name: grigorynadolinsky
      url-base: https://github.com/GrigoryNadolinsky
  projects:
    - name: zmk
      remote: zmkfirmware
      revision: feat/pointers-move-scroll
      import: app/west.yml
    - name: zmk-pmw3610-driver-maccel
      remote: grigorynadolinsky
      revision: main
  self:
    path: config
```
